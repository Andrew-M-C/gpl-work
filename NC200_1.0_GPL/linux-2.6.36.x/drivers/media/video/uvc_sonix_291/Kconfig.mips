## NC200_1.0_GPL/linux-2.6.36.x/drivers/media/video/uvc_sonix_291/Kconfig.mips
```kconfig
config USB_SONiX_UVC_SN9C29x
	tristate "SONiX SN9C29x USB Video Class (UVC)"
	---help---
	  Support for the SONiX SN9C291/SN9C292 USB Video Class (UVC).  Currently only video
	  input devices, such as webcams, are supported.

	  For more information see: <http://linux-uvc.berlios.de/>

config  USB_SONiX_UVC_SN9C29x_INPUT_EVDEV
	bool "UVC input events device support"
	default y
	depends on USB_SONiX_UVC_SN9C29x=INPUT || INPUT=y
	---help---
	  This option makes SONiX USB SN9C29x Video Class devices register an input device
	  to report button events.

	  If you are in doubt, say Y.
```
